## drivers/huawei_platform/power/hardware_monitor/vbus_check/Kconfig
```kconfig
#
# vbus abnormal monitor drivers
#

config HUAWEI_VBUS_CHECK
	bool "vbus abnormal monitor"
	default n
	help
	  Say Y here to enable vbus abnormal monitor driver.
```

## drivers/hwpower/Kconfig
```kconfig
#
# huawei power common drivers
#

source "drivers/hwpower/cc_common_module/Kconfig"
source "drivers/hwpower/cc_adapter/Kconfig"
source "drivers/hwpower/cc_hardware_ic/Kconfig"
source "drivers/hwpower/cc_hardware_monitor/Kconfig"
```

## drivers/hwpower/cc_hardware_ic/Kconfig
```kconfig
#
# huawei hardware ic drivers
#

source "drivers/hwpower/cc_hardware_ic/coul/Kconfig"
source "drivers/hwpower/cc_hardware_ic/buck_boost/Kconfig"
```

## drivers/hwpower/cc_hardware_ic/coul/Kconfig
```kconfig
#
# huawei coul drivers
#

config HUAWEI_COUL
	bool "huawei coul"
	default n
	help
	  Say Y here to enable huawei coul driver.
	  This driver provides a unified interface to the coul.
	  Currently supported coul as below.
	  bq27z561
	  rt9426 & rt9426a

config HUAWEI_COUL_BQ27Z56X
	bool "coul with bq27z561"
	depends on HUAWEI_COUL
	default n
	help
	  Say Y here to enable bq27z561 coul driver.

config HUAWEI_COUL_RT9426X
	bool "coul with rt9426 & rt9426a"
	depends on HUAWEI_COUL
	default n
	help
	  Say Y here to enable rt9426 & rt9426a coul driver.
```

## drivers/hwpower/cc_hardware_monitor/Kconfig
```kconfig
#
# huawei hardware monitor drivers
#

source "drivers/hwpower/cc_hardware_monitor/lga_check/Kconfig"
source "drivers/hwpower/cc_hardware_monitor/water_detect/Kconfig"
source "drivers/hwpower/cc_hardware_monitor/ffc_control/Kconfig"
```

## drivers/mfd/hisi_hi6562_pmic_mipi/Kconfig
```kconfig
config HISI_HI6562_PMIC_MIPI
		tristate "HiSilicon platform hi6562 pmic mipi"
		depends on OF
        help
          This driver supports HiSilicon platform hi6562 power to control TOF cameras.
```

## drivers/power/hisi/eis/Kconfig
```kconfig
config HISI_EIS
	bool "hisi eis"
	default n
	help
	  Electrochemical Impedance Spectroscopy.

if HISI_EIS
config HISI_EIS_FREQ
	bool "hisi eis freq"
	default n
	help
	  hisi eis frequency domain method.

config HISI_EIS_TIME
	bool "hisi eis time"
	default n
	help
	   hisi eis time domain method.

config HISI_EIS_WAVELET
	bool "hisi eis wavelet"
	default n
	help
	  hisi eis wavelet method.

config HISI_EIS_VERBOSE_DEBUG
	bool "hisi eis verbose debug"
	default n
	help
	  hisi eis verbose debug
endif

source drivers/power/hisi/eis/pmic/Kconfig
```

## drivers/power/hisi/eis/pmic/Kconfig
```kconfig
config HISI_EIS_PMIC
	bool "hisi eis hardware in pmic"
	default n
	depends on HISI_EIS
	help
	  hardware in pmic for eis.
```

## drivers/swapfile/Kconfig
```kconfig
#
# Huawei swapfile driver configuration
#

config HUAWEI_SWAPFILE
	bool "huawei swapfile driver"
	depends on HIBERNATION
	default n
	help
	  swapfile driver supports swapfile's dynamic mount and umount for hibernate.
```

## drivers/thermal/hisi/hw_dpm/Kconfig
```kconfig
config HISI_DPM_HWMON
	bool "dpm hwmon driver config"
	default n
	help
	  Driver for kernel dpm
config HISI_DPM_HWMON_V1
	bool "dpm hwmon first version config"
	depends on HISI_DPM_HWMON
	default n
	help
	  First version for kernel dpm
config HISI_DPM_HWMON_V2
	bool "dpm hwmon second version config"
	depends on HISI_DPM_HWMON
	default n
	help
	  Second version for kernel dpm
config HISI_DPM_HWMON_DEBUG
	bool "dpm hwmon driver for fitting debug"
	depends on HISI_DPM_HWMON
	default n
	help
	  Driver for kernel dpm debug
config HISI_MODEM_DPM
	bool "modem dpm hwmon config"
	depends on HISI_DPM_HWMON
	default n
	help
	  Driver for modem dpm
```

## drivers/usb/dwc3/hisi/Kconfig
```kconfig
config USB_DWC3_HISI
	tristate "Hisilicon Platforms"
	default USB_DWC3
	select HISI_USB_HELPER
	select HISI_USB_REG_CFG
	help
	  Support of USB2/3 functionality in hisilicon platforms,
	  Say 'Y' or 'M' here if you have one such device.

if USB_DWC3_HISI

config USB_DWC3_NOV
       tristate "Hisilicon Platforms NOV USB"
       default n
       help
         Support of USB2 functionality in hisilicon platforms,
         Say 'Y' or 'M' here if you have one such device.

config USB_DWC3_OCT
       tristate "Hisilicon Platforms OCT USB"
       default n
       help
         Support of USB2 functionality in hisilicon platforms,
         Say 'Y' or 'M' here if you have one such device.

config USB_DWC3_SEP
       tristate "Hisilicon Platforms SEP USB"
       default n
       help
         Support of USB2 functionality in hisilicon platforms,
         Say 'Y' or 'M' here if you have one such device.

config USB_DWC3_AUG
       tristate "Hisilicon Platforms AUG USB"
       default n
       help
         Support of USB2 functionality in hisilicon platforms,
         Say 'Y' or 'M' here if you have one such device.

config USB_DWC3_APR
	tristate "Hisilicon Platforms APR USB"
	select HISI_USB_XHCI_HUB_PORT_DIS
	default n
	select HISI_USB_REG_CFG
	help
	  Support of USB2/3/3.1 functionality in hisilicon platforms,
	  Say 'Y' or 'M' here if you have one such device.

config USB_DWC3_MAR
	tristate "Hisilicon Platforms MAR USB"
	select HISI_USB_XHCI_HUB_PORT_DIS
	default n
	select HISI_USB_REG_CFG
	help
	  Support of USB2/3/3.1 functionality in hisilicon platforms,
	  Say 'Y' or 'M' here if you have one such device.

config CONTEXTHUB_PD
	bool "Sensor CONTEXTHUB PD driver"
	default n
	help
	  Say yes here if you want to use contexthub pd function

if CONTEXTHUB_PD
config HISI_COMBOPHY
	tristate "Hisilicon Platforms MAR USB"
	default n
	help
	  Support of USB2/3/3.1 functionality in hisilicon platforms,
	  Say 'Y' or 'M' here if you have one such device.
endif # CONTEXTHUB_PD

config HISI_USB_NEW_FRAME
       tristate "USB new hardware config frame for Hisilicon Platforms"
       default n
       help
         Support for new usb phy and controller config frame for Hisilicon USB
         Say 'Y' or 'M' here if you have one such device.

endif # USB_DWC3_HISI
```

## drivers/vcodec/hi_vcodec/Kconfig
```kconfig
menu "VCODEC DRIVER Configuration"

config VCODEC_PLATFORM_HIVCODECV210
        tristate "v210 Vcodec configs"
        default n

config VCODEC_PLATFORM_KIRIN970
        tristate "970 Vcodec configs"
        default n

config VCODEC_PLATFORM_HIVCODECV300
        tristate "v300 Vcodec configs"
        default n

config VCODEC_PLATFORM_HIVCODECV310
       tristate "v310 Vcodec configs"
       default n

config VCODEC_PLATFORM_HIVCODECV500
        tristate "v500 Vcodec configs"
        default n

config VCODEC_PLATFORM_HIVCODECV600
        tristate "v600 Vcodec configs"
        default n

config VCODEC_DPM_ENABLE
        bool "dpm hwmon second version config"
        depends on HISI_DPM_HWMON
        default n
        help
            Second version for kernel dpm

source "drivers/vcodec/hi_vcodec/vdec_hivna/Kconfig"
source "drivers/vcodec/hi_vcodec/venc_hivna/drv/venc/Kconfig"

endmenu
```

## drivers/vcodec/hi_vcodec/vdec_hivna/Kconfig
```kconfig
menu "Hisilicon video vdec support"
config HI_VCODEC_VDEC_HIVNA
    tristate "Hisilicon video decoder support"
    default n
    help
      This is the hisilicon decoder driver

config VDEC_TVP_SUPPORT
    bool "Vdec vfmw tvp support"
    depends on HI_VCODEC_VDEC_HIVNA
    default n
endmenu
```

## drivers/video/fbdev/hisi/Kconfig
```kconfig
config HISI_FB_MEDIACOMMON
	tristate
	depends on FB
	default n
	---help---
	Enable mediacommon hardware support for hisilicon chipset

	This will allow for allocating new framebuffer to provide more
	interfaces such as ispif, precompose copybit etc.

config HISI_FB_ALSC
	tristate
	depends on FB
	default n
	---help---
	Enable ALSC hardware support for hisilicon chipset

config HISI_FB_FAKE
	tristate "HISI Framebuffer Fake support"
	depends on FB
	select FB_CFB_FILLRECT
	select FB_SYS_FOPS
	select FB_CFB_COPYAREA
	select FB_CFB_IMAGEBLIT
	select REGMAP
	help
	  This framebuffer driver supports HISI FB Fake.

config HISI_FB_970
	tristate "HISI FB 970 Framebuffer support"
	depends on FB
	select FB_CFB_FILLRECT
	select FB_SYS_FOPS
	select FB_CFB_COPYAREA
	select FB_CFB_IMAGEBLIT
	select REGMAP
	help
	  This framebuffer driver supports HISI970 FB.

config HISI_FB_V501
	tristate "HISI FB V501 Framebuffer support"
	depends on FB
	select FB_CFB_FILLRECT
	select FB_SYS_FOPS
	select FB_CFB_COPYAREA
	select FB_CFB_IMAGEBLIT
	select HISI_FB_MEDIACOMMON
	select REGMAP
	help
	  This framebuffer driver supports HISI V501 FB.

config HISI_FB_V510
	tristate "HISI FB V510 Framebuffer support"
	depends on FB
	select FB_CFB_FILLRECT
	select FB_SYS_FOPS
	select FB_CFB_COPYAREA
	select FB_CFB_IMAGEBLIT
	select HISI_FB_MEDIACOMMON
	select HISI_DPP_CMDLIST
	select REGMAP
	help
	  This framebuffer driver supports HISI V510 FB.

config HISI_FB_V600
	tristate "HISI FB V600 Framebuffer support"
	depends on FB
	depends on DMA_CMA
	select FB_CFB_FILLRECT
	select FB_SYS_FOPS
	select FB_CFB_COPYAREA
	select FB_CFB_IMAGEBLIT
	select HISI_FB_MEDIACOMMON
	select HISI_FB_ALSC
	select REGMAP
	help
	  This framebuffer driver supports HISI V600 FB.

config HISI_FB_V320
	tristate "HISI FB V320 Framebuffer support"
	depends on FB
	select FB_CFB_FILLRECT
	select FB_SYS_FOPS
	select FB_CFB_COPYAREA
	select FB_CFB_IMAGEBLIT
	select REGMAP
	help
	  This framebuffer driver supports HISI V320 FB.

config HISI_FB_AOD
	tristate "HISI aod support"
	depends on FB
	select FB_CFB_FILLRECT
	select FB_SYS_FOPS
	select FB_CFB_COPYAREA
	select FB_CFB_IMAGEBLIT
	select REGMAP
	help
	  This framebuffer driver supports hisi aod.

config HISI_FB_V330
	tristate "HISI FB V330 Framebuffer support"
	depends on FB
	select FB_CFB_FILLRECT
	select FB_SYS_FOPS
	select FB_CFB_COPYAREA
	select FB_CFB_IMAGEBLIT
	select REGMAP
	help
	  This framebuffer driver supports HISI V330 FB.

config HISI_FB_V350
	tristate "HISI FB V350 Framebuffer support"
	depends on FB
	select FB_CFB_FILLRECT
	select FB_SYS_FOPS
	select FB_CFB_COPYAREA
	select FB_CFB_IMAGEBLIT
	select REGMAP
	help
	  This framebuffer driver supports HISI V350 FB.

config HISI_FB_V345
	tristate "HISI FB V345 Framebuffer support"
	depends on FB
	select FB_CFB_FILLRECT
	select FB_SYS_FOPS
	select FB_CFB_COPYAREA
	select FB_CFB_IMAGEBLIT
	select REGMAP
	help
	  This framebuffer driver supports HISI V345 FB.

config HISI_FB_V346
	tristate "HISI FB V346 Framebuffer support"
	depends on FB
	select FB_CFB_FILLRECT
	select FB_SYS_FOPS
	select FB_CFB_COPYAREA
	select FB_CFB_IMAGEBLIT
	select REGMAP
	help
	  This framebuffer driver supports HISI V346 FB.

config DSS_SMMU_V3
	tristate "HISI FB smmu v3 support"
	depends on ARM_SMMU_V3
	help
	  This framebuffer driver supports smmu v3.

config HISI_FB_ENG_DBG
	tristate "HISI FB ENG DEBUG support"
	depends on FB
	help
	  This config only used in eng version.

config FASTBOOT_DISP_ENABLE
	tristate "HISI fastboot display enable support"
	depends on FB
	help
	  Display system have already initialized in fastboot.

config HISI_DISPLAY_DFR
	tristate "HISI FB dynamic frame adaptation support"
	depends on FB
	help
	  This framebuffer driver supports dynamic frame adaptation.

config HISI_DSS_DPM
	tristate "HISI DSS DPM(digital power monitor) support"
	depends on FB
	depends on HISI_DPM_HWMON
	help
	  This framebuffer driver supports dpm function.

config HISI_DPP_CMDLIST
	tristate "HISI DSS DPP cmdlist support"
	depends on FB
	help
	  This framebuffer driver supports dpp cmdlist function.

config HW_DSS_BOOST
	tristate "huawei dss boost support"
	depends on HISI_FB_V501 || HISI_FB_V510 || HISI_FB_V350 || HISI_FB_V345 || HISI_FB_V346 || HISI_FB_V600
	default y
	help
	  support boosting for the huawei dss.

config CDC_MULTI_DISPLAY
	tristate "CDC support multi-screen"
	depends on HISI_FB_V510
	default n
	help
	  This framebuffer driver supports CDC multi-screen.

config DP_CDC
	tristate "CDC support DP"
	depends on HISI_FB_V510
	default n
	help
	  This framebuffer driver supports CDC DP.

source "drivers/video/fbdev/hisi/mdfx/Kconfig"
```
