## drivers/huawei_platform/power/battery/battery_temp/Kconfig
```kconfig
#
# Huawei battery temperature configuration
#

config HUAWEI_BATTERY_TEMP
	bool "huawei battery temperature"
	default n
	help
	  Say Y here to enable huawei temperature support.
	  Support multi battery temperature.
	  Compatible with hisi coul driver.
	  Need to register a instance by huawei_battery_temp_register.

config HUAWEI_MULTI_BATT_TEMP
	bool "huawei multi battery temperature"
	default n
	depends on HUAWEI_BATTERY_TEMP
	help
	  Say Y here to enable multi battery temperature module.
	  This module monitor multi battery temperature,
	  and mixed multi battery temperature.
	  Should register to HUAWEI_BATTERY_TEMP module.

config HUAWEI_MULTI_BTB_TEMP
	bool "huawei multi btb temperature"
	default n
	depends on HUAWEI_BATTERY_TEMP
	help
	  Say Y here to enable multi btb temperature module.
	  This module monitor multi btb temperature,
	  and mixed multi btb temperature.
	  Should register to HUAWEI_BATTERY_TEMP module.
```

## drivers/huawei_platform/power/hardware_ic/Kconfig
```kconfig
source "drivers/huawei_platform/power/hardware_ic/charger_ic/Kconfig"
source "drivers/huawei_platform/power/hardware_ic/load_switch/Kconfig"
source "drivers/huawei_platform/power/hardware_ic/switch_capacitor/Kconfig"
source "drivers/huawei_platform/power/hardware_ic/charge_adc_monitor/Kconfig"
source "drivers/huawei_platform/power/hardware_ic/boost_5v/Kconfig"
source "drivers/huawei_platform/power/hardware_ic/charge_pump/Kconfig"
source "drivers/huawei_platform/power/hardware_ic/wireless_charge_ic/Kconfig"
```

## drivers/huawei_platform/power/hardware_ic/load_switch/Kconfig
```kconfig
#
# huawei load switch for direct charge drivers
#

config LOADSWITCH
	bool "load_switch"
	depends on DIRECT_CHARGER
	default n
	help
	  Say Y here to enable load switch driver.
	  This driver provides a unified interface for load switch.
	  Support device:
	  rt9748

config RT9748
	bool "rt9748_for_direct_charge"
	depends on LOADSWITCH
	default n
	help
	  Say Y here to enable rt9748 driver.
	  RT9748 is a 6-A smart load switch battery charger, which integrates an
	  internal load switch with charge pump control and 4-path constant current
	  and constant voltage regulation, a 5-way hardware protection, and a 10-channel
	  12-bit ADC converter.

config DUAL_LOADSWITCH
	bool "dual_load_switch"
	depends on DIRECT_CHARGER
	default n
	help
	  Say Y here to enable dual load switch driver.
	  This driver provides a unified interface for dual load swtich.
	  Support device:
	  dual_rt9748
	  dual_fpf2283

config DUAL_LOADSWITCH_RT9748
	bool "dual_loadswitch_rt9748"
	depends on DUAL_LOADSWITCH
	default n
	help
	  Say Y here to enable dual rt9748 driver.
	  RT9748 is a 6-A smart load switch battery charger, which integrates an
	  internal load switch with charge pump control and 4-path constant current
	  and constant voltage regulation, a 5-way hardware protection, and a 10-channel
	  12-bit ADC converter.

config DUAL_LOADSWITCH_FPF2283
	bool "dual_loadwitch_fpf2283"
	depends on DUAL_LOADSWITCH
	default n
	help
	  Say Y here to enable dual fpf2283 driver.
```
