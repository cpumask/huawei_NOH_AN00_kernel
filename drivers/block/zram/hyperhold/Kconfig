## drivers/block/zram/hyperhold/Kconfig
```kconfig
# SPDX-License-Identifier: GPL-2.0
# Hyperhold container backend device configuration

# Selected when system need hyperhold container
config HYPERHOLD_CORE
	bool "Hyperhold container device support"
	depends on ZRAM && HYPERHOLD && ZS_MALLOC_EXT
	default n
	---help---
	  Say Y here if you want to use the hyperhold
	  as the backend device in ZRAM.
	  If unsure, say N here.
	  This module can't be compiled as a module,
	  the module is as one part of the ZRAM driver.
```

## drivers/contexthub/flp/Kconfig
```kconfig
#
# FLP driver configuration
#

menu "HISI FLP configuration"

config HISI_SOFTTIMER
	bool "HISI SOFTTIMER support"
	depends on CONTEXTHUB
	default n
	---help---
	  Enable support for softtimer driver

config HISI_FLP
	bool "HISI FLP support"
	depends on HISI_SOFTTIMER
	default n
	---help---
	  Enable support for FLP driver

config HISI_FLP_GEOFENCE
	bool "HISI FLP GEOFENCE support"
	depends on HISI_FLP
	default n
	---help---
	  Enable support for GEOFENCE driver

config HISI_FLP_CELLFENCE
	bool "HISI FLP CELLFENCE support"
	depends on HISI_FLP
	default n
	---help---
	  Enable support for CELLFENCE driver

config HISI_FLP_WIFIFENCE
	bool "HISI_FLP_WIFIFENCE support"
	depends on HISI_FLP
	default n
	---help---
	  Enable support for WIFIFENCE driver

config HISI_FLP_BATCHING
	bool "HISI_FLP_BATCHING support"
	depends on HISI_FLP
	default n
	---help---
	  Enable support for BATCHING driver

config HISI_FLP_DIAG
	bool "HISI_FLP_DIAG support"
	depends on HISI_FLP
	default n
	---help---
	  Enable support for DIAG driver

config HISI_AR
	bool "HISI AR support"
	depends on HISI_SOFTTIMER
	default n
	---help---
	  Enable support for AR driver

config CONTEXTHUB_UNIFORM_INTERVAL
	bool "HISI CONTEXTHUB_UNIFORM_INTERVAL support"
	depends on HISI_AR
	default n
	---help---
	  Enable support for CONTEXTHUB_UNIFORM_INTERVAL driver

endmenu
```

## drivers/contexthub/swing/Kconfig
```kconfig
config CONTEXTHUB_SWING
	bool "swing driver"
	depends on INPUTHUB_20
	default n
	help
	Swing driver support aonn.

config CONTEXTHUB_SWING_DBG
	bool "swing dbg drvier"
	depends on INPUTHUB_20
	default n
	help
	Swing debug drvier support aonn.

config CONTEXTHUB_SWING_20
	bool "swing 2.0"
	default n
	help
	  swing 2.0 config
config CONTEXTHUB_SWING_TOF
	bool "swing tof"
	default n
	help
	Swing tof driver
```

## drivers/devfreq/hisi/Kconfig
```kconfig
config HISI_DEVFREQ
	tristate "Hisilicon DEVFREQ Driver"
	depends on ARCH_HISI && PM_DEVFREQ
	select PM_OPP
	help
	  Hisilicon devfreq driver common module.

source "drivers/devfreq/hisi/ddr_devfreq/Kconfig"
source "drivers/devfreq/hisi/dsu_pctrl/Kconfig"
source "drivers/devfreq/hisi/gpu_devfreq/Kconfig"
source "drivers/devfreq/hisi/l3c_devfreq/Kconfig"
source "drivers/devfreq/hisi/mem_lat/Kconfig"
source "drivers/devfreq/hisi/npu_devfreq/Kconfig"
```

## drivers/devfreq/hisi/gpu_devfreq/Kconfig
```kconfig
config DEVFREQ_GOV_GPU_SCENE_AWARE
	tristate "Hisilicon GPU Scene Aware"
	depends on ARCH_HISI && PM_DEVFREQ
	select PM_OPP
	select HISI_DEVFREQ

config GPU_RT_DEVFREQ
	bool "force update devfreq when gpu in runtime"
	default n
	depends on DEVFREQ_GOV_GPU_SCENE_AWARE

config GPUFREQ_GOV_POLICY_USING_DTSI
	bool "Hisilicon gpu governor policy using dtsi"
	default n
	depends on DEVFREQ_GOV_GPU_SCENE_AWARE
```

## drivers/devfreq/hisi/npu_devfreq/Kconfig
```kconfig
config DEVFREQ_GOV_NPU_PM_QOS
	tristate "Hisilicon NPU PM QOS"
	depends on ARCH_HISI && PM_DEVFREQ
	select PM_OPP
	select HISI_DEVFREQ
```

## drivers/gpu/arm/Kconfig
```kconfig
#
# (C) COPYRIGHT 2012 ARM Limited. All rights reserved.
#
# This program is free software and is provided to you under the terms of the
# GNU General Public License version 2 as published by the Free Software
# Foundation, and any use by you of this program is subject to the terms
# of such GNU licence.
#
# A copy of the licence is included with the program, and can also be obtained
# from Free Software Foundation, Inc., 51 Franklin Street, Fifth Floor,
# Boston, MA  02110-1301, USA.
#
#

config MALI_HEIMDALL
        tristate "Mali tHEx configs"
        default n

config MALI_SIGURD
        tristate "Mali tSIx configs"
        default n

config MALI_NORR
        tristate "Mali tNOx configs"
        default n

config MALI_NORR_PHX
        tristate "Mali tNOx_PHX configs"
        default n

config MALI_GONDUL
        tristate "Mali tGOx configs"
        default n

config MALI_BORR
	tristate "Mali tBOx configs"
	default n

config MALI_TRYM
        tristate "Mali tTRx configs"
        default n

config MALI_NATT
        tristate "Mali tNAx configs"
        default n

menu "ARM GPU Configuration"

if MALI_HEIMDALL
#source "drivers/gpu/arm/bifrost-r2p0-03rel0/Kconfig"
#source "drivers/gpu/arm/bifrost-r4p0-01rel0/Kconfig"
#source "drivers/gpu/arm/bifrost-r6p0-cet/Kconfig"
#source "drivers/gpu/arm/bifrost-r7p0-00cet0/Kconfig"
endif

if MALI_SIGURD
#source "drivers/gpu/arm/bifrost-r7p0-00cet0/Kconfig"
endif

if MALI_NORR
#source "drivers/gpu/arm/bifrost-r6p0-cet/Kconfig"
#source "drivers/gpu/arm/bifrost-r7p0-00cet0/Kconfig"
endif

if MALI_NORR_PHX
endif

if MALI_GONDUL
endif

if MALI_BORR
source "drivers/gpu/arm/valhall-r23p0-01rel0/Kconfig"
endif

if MALI_TRYM
#source "drivers/gpu/arm/valhall-r23p0-01rel0/Kconfig"
endif

if MALI_NATT
source "drivers/gpu/arm/valhall-r23p0-01rel0/Kconfig"
endif

endmenu
```

## drivers/gpu/drm/hisi/heap/Kconfig
```kconfig
config DRM_GEM_HEAP
	bool "Enable heap memory manager feature"
	depends on DRM_DSS_IOMMU
	default n
	help
	  DRM GEM Heap feature
```

## drivers/hisi/file_encry/Kconfig
```kconfig
config HISI_FILE_BASED_ENCRYPTO
	bool "HISI FEB3 support"
	default n
	help
	  Say yes here to support the HISI FBE3

config HISI_FILE_BASED_ENCRYPTO_DBG
	bool "HISI FEB3 debug support"
	depends on HISI_FILE_BASED_ENCRYPTO
	depends on HISI_DEBUG_FS
	default n
	help
	  Say yes here to support the HISI FBE3 debug
```

## drivers/hisi/gpufreq/Kconfig
```kconfig
menu "HISI GPUFREQ Options"

config HISI_GPUFREQ
    tristate "Hisilicon GPUFREQ Driver"
    depends on ARCH_HISI && PM_DEVFREQ
    select PM_OPP
    help
      This enables the hisilicon gpufreq driver.

config HISI_GPU_FHSS
    tristate "Hisilicon GPU Frequency-Hopping Spread Spectrum Driver"
    depends on HISI_GPUFREQ
    help
      This enables the hisilicon Frequency-Hopping Spread Spectrum of GPU feature.

config HISI_GPUTOP_FREQ
    tristate "Hisilicon GPUTOP Driver"
    depends on HISI_GPUFREQ
    help
      This enables the hisilicon GPUTOP feature.

config HISI_GPUTOP_FREQ_DEBUG
    tristate "Hisilicon GPUTOP Driver debug"
    depends on HISI_GPUTOP_FREQ
    help
      This enables the hisilicon GPUTOP debug feature.

endmenu
```

## drivers/hisi/hhee/Kconfig
```kconfig
config HISI_HHEE
	bool "HISI HHEE support"
	default n
	help
	  Say yes here to support the HISI HHEE

config HISI_HHEE_TOKEN
	bool "HISI TOKEN for hhee"
	depends on HISI_HHEE
	default n
	help
	  Say yes when token needed

config HISI_MODULE_ALLOC
	bool "HISI overload module_alloc for hhee"
	depends on HISI_HHEE
	default n
	help
	  Say yes when overload is needed

config HISI_HHEE_DEBUG
	bool "HISI HHEE test support"
	depends on !UBSAN && !KCOV && !KASAN
	depends on HISI_HHEE
	depends on HISI_DEBUG_FS
	default n
	help
	  Say yes here to support the HISI HHEE debug

config HISI_UEFI_HHEE
	bool "HISI HHEE support for UEFI boot"
	depends on HISI_HHEE
	default n
	help
	  Say yes here to support HHEE when kernel boot form UEFI

config HISI_PRMEM
	bool "Write protect critical data not requiring high write speed."
	default n
	help
	  Selected data can be tagged/allocated in such a way that it
	  becomes read-only, with the option of allowing for modifications
	  through specific API. Run-time allocation must also use such API.
	  Saying No here will revert to basic kernel vmalloc.

config HISI_PRMEM_BYPASS
	bool "Let the allocator active, but do not protect the memory"
	depends on HISI_PRMEM
	default n
	help
	  Useful for debugging or for testing existing code while it is
	  being converted to the prmem API.
	  Saying Yes here will not write protect the allocations.

config DEBUG_HISI_PRMEM
	bool "Run self test for protected memory (prmem)"
	depends on HISI_PRMEM
	default n
	help
	  Verifies that the protected memory interface works correctly.

config HHEE_USING_IPI
	bool "HISI HHEE Using IPI interrupt"
	depends on HISI_HHEE
	default n
	help
	  Say yes here to support using IPI not GIC
```

## drivers/hisi/hisi_dpm/Kconfig
```kconfig
config HISI_LPMCU_DDR_VOTE
	bool "count lpmcu or ddr vote time"
	default n
	help
	Driver for lpmcu vote time
```

## drivers/hisi/isp/Kconfig
```kconfig
config HISI_ISP_DEBUG
	bool "hisi isp debug"
	default n
	help
		Say yes here to support hisi isp debug.

config HISI_ISP_SMMU_BYPASS_DEBUG
	bool "hisi isp smmu bypass debug"
	default n
	help
		Say yes here to support hisi isp smmu bypass debug.

config HISI_ISP_DPM
	tristate "HISI ISP DPM(digital power monitor) support"
	depends on HISI_DPM_HWMON
	default n
	help
		This framebuffer driver supports dpm function.
```

## drivers/hisi/l3cache/Kconfig
```kconfig
menu "Hisi L3 Cache"
config HISI_L3CACHE_EXTENSION
	bool "l3cache extension"
	depends on HISI_LB_L3_EXTENSION
	default n
	help
	 support l3cache extension

config HISI_L3CACHE_EXTENSION_DYNAMIC
	bool "l3cache extension dynamic"
	depends on HISI_L3CACHE_EXTENSION
	default n
	help
	 support l3cache extension on/off dynamicly

config HISI_L3CACHE_EXTENSION_DEBUG
	bool "l3cache extension debug"
	depends on HISI_L3CACHE_EXTENSION
	default n
	help
	 support l3cache extension debug

config HISI_L3CACHE_SHARE
	bool "l3cache share"
	default n
	help
	 support l3cache share

config HISI_L3CACHE_SHARE_PERF
	bool "l3cache share perf"
	depends on HISI_L3CACHE_SHARE && ARM64_DSU_PCTRL_DEVFREQ
	default n
	help
	 support l3cache share perf

config HISI_L3CACHE_SHARE_DEBUG
	bool "l3cache share debug"
	depends on HISI_L3CACHE_SHARE
	default n
	help
	 support l3cache share debug

config HISI_L3CACHE_LP_DEBUG
	bool "l3cache lowpower debug"
	default n
	help
	 support l3cache low power debug

endmenu
```

## drivers/hisi/max_power/Kconfig
```kconfig
menu "Hisi max power options"

config HISI_MAX_POWER
	bool "Hisilicon max power"
	default n
	help
	  Hisilicon max power drivers
	  eng version need this config
	  begin from eromitlab plat

endmenu
```

## drivers/hisi/mspc/Kconfig
```kconfig
config HISI_MSPC
	depends on HISI_MAILBOX
	bool "Hisilicon MSP core "
	default n
	help
	  Hisi MSP core driver

config HISI_MSPC_MNTN_RESET_IRQ_SEPARATE
        depends on HISI_MSPC
        bool "Hisilicon mspc reset use separate interrupts."
        default n
        help
          whether mspc reset support separate interrupts feature

config MSPC_SUPPORT_DCS
        depends on HISI_MSPC
	bool "Support for Dynamic Binaries upgrade"
        default n
        help
	  whether to support dynamic binaries upgrade in Hisee
```

## drivers/hisi/npu/device/Kconfig
```kconfig
config NPU_DEVDRV_DEVDRIVER
	tristate "NPU DEVDRV DEVDRIVER"
	default y
config HISI_NPU_DPM_ENABLED
	bool "only open on hisi_kirin990_defconfig, HISI_NPU_DPM_ENABLED depends on HISI_DPM_HWMON"
	depends on HISI_DPM_HWMON
	default n
	help
	  Driver for npu dpm
```

## drivers/hisi/perfhub/Kconfig
```kconfig
config HISI_PERFHUB
	bool "hisi perfhub"
	default n

config HISI_FREQ_LIMIT_COUNTER
	bool "counts cpu/gpu freq limit"
	default n
	depends on HISI_IPA_THERMAL
	depends on HISI_EAS_SCHED
```

## drivers/hisi/tzdriver/Kconfig
```kconfig
menu "TEE OS"

config TZDRIVER
	tristate "Secure Execution Communicator driver"
	default n
	help
	  Provides a communication interface between userspace and
	  TrustZone Operating Environment.

config CPU_AFF_NR
	int "Default Cpu Affinity"
	default 0

config DRM_ADAPT
	bool "Drm Feature Adapt"
	default n
	depends on TZDRIVER
	help
	  Drm Feature Adapt

config TEEECD_AUTH
	bool "Teec Daemon Path Hash Auth"
	default n
	depends on TZDRIVER
	help
	  TEEOS TEECD path hash auth

config CLIENT_AUTH
	bool "Client Application Hash Auth"
	default n
	depends on TZDRIVER
	help
	  TEEOS CA code hash auth

config ANDROID_HIDL
	bool "Android Hidl Adapt"
	default n
	depends on CLIENT_AUTH
	help
	  TEEOS hidl proc auth

config SELINUX_ADAPT
	bool "Selinux Interface Adapt"
	default n
	depends on TEEECD_AUTH || CLIENT_AUTH
	help
	  Selinux Interface Adapt

config AUTH_ENHANCE
	bool "Secure Execution Auth Enhance"
	default n
	depends on CLIENT_AUTH
	help
	  TEEOS auth enhance

config TEE_AUDIT
	bool "Audit TA"
	default n
	depends on AUTH_ENHANCE
	help
	  Audit TA in case of evil TA

config DYNAMIC_ION
	bool "Dynamic Ion Feature"
	default n
	depends on TZDRIVER
	help
	  TEEOS dynamic ion

config STATIC_ION
	bool "Static Ion Feature"
	default n
	depends on TZDRIVER
	help
	  TEEOS static ion

config RDR_MEM
	bool "Register Rdr Mem"
	default n
	depends on TZDRIVER
	help
	  Register Rdr Mem

config TEELOG
	bool "Secure Execution Log Driver"
	default n
	depends on TZDRIVER
	help
	  TEEOS log

config TEE_LOG_ACHIVE_PATH
	string "Tee log achive path"
	default "/data/log/tee/last_teemsg"
	depends on TEELOG
	help
	  Last tee msg log path

config TEE_KTRACE
	bool "TEEOS Kernel Event Log Driver"
	default n
	depends on TEELOG
	help
	  TEEOS event trace

config TEE_LOG_EXCEPTION
	bool "Log Exception Info to Imonitor"
	default n
	depends on TEELOG
	help
	  Log exception info to imonitor

config KERNEL_CLIENT
	bool "Kernel Client Interface"
	default n
	depends on TZDRIVER
	help
	  Kernel Client Interface

config TEE_TUI
	bool "Trusted User Interface Driver"
	default n
	depends on TZDRIVER
	help
	  Trusted user interface diver

config TEE_TUI_FP
	bool "Trusted User Interface Driver For FP"
	default n
	depends on TZDRIVER
	help
	  Trusted user interface diver

config HISI_SECBOOT_IMG
	bool "tzdriver split secboot img into modem and ap"
	default n
	depends on KERNEL_CLIENT
	help
	  Macro defined for splitting modem and ap img

config HISI_SECBOOT_IMG_V2
	bool "tzdriver split modem and ap for v2"
	default n
	depends on KERNEL_CLIENT
	help
	  Macro defined for splitting modem and ap img v2

config ASAN_DEBUG
	bool "hisi ASAN debug version"
	default n
	help
	  Macro defined for ASAN debug version

config BIG_SESSION
	bool "open more sessions"
	default n
	depends on TZDRIVER
	help
	  TEEOS open more sessions


endmenu
```

## drivers/huawei_armpc_platform/audiokit/Kconfig
```kconfig
#
# Audiokit configuration
#
menuconfig ARMPC_AUDIOKIT
bool "Audio Kit"
default n
help
 choose y to open Audio Kit
if ARMPC_AUDIOKIT
source "drivers/huawei_armpc_platform/audiokit/dsm_audio/Kconfig"
source "drivers/huawei_armpc_platform/audiokit/boxid/Kconfig"
source "drivers/huawei_armpc_platform/audiokit/smartpakit/Kconfig"
source "drivers/huawei_armpc_platform/audiokit/ana_hs_kit/Kconfig"
endif
```

## drivers/huawei_armpc_platform/pcie2usb/Kconfig
```kconfig
#sensor unification for differ platform
menuconfig HUAWEI_ARMPC_PCIE2USB
	bool "huawei armpc PCIE2USB device"
	default n
	help
	Say yes here to support pcie2usb control for huawei arm PC.
```
